## os/package/fsverity-utils/Config.in
```kconfig
  config BR2_PACKAGE_FSVERITY_UTILS
	bool "fsverity-utils"
	help
	  Userspace fsverity utilities.
```

## os/package/python-binwalk/Config.in
```kconfig
config BR2_PACKAGE_PYTHON_BINWALK
	bool "python-binwalk"

	depends on BR2_PACKAGE_PYTHON3

	help
	  Binwalk RE tool: https://github.com/ReFirmLabs/binwalk
	  
```

## os/package/python-binwalk/Config.in.host
```kconfig
config BR2_PACKAGE_HOST_PYTHON_BINWALK
	bool "python-binwalk-host"

	help
	  Binwalk RE tool: https://github.com/ReFirmLabs/binwalk
	  
```

## os/package/python-cryptoauthlib/Config.in
```kconfig
config BR2_PACKAGE_PYTHON_CRYPTOAUTHLIB
	bool "python-cryptoauthlib"

	depends on BR2_PACKAGE_CRYPTOAUTHLIB
	select BR2_PACKAGE_CRYPTOAUTHLIB_ATCAB_FUNCTIONS

	help
	  CryptoAuthLib - Microchip CryptoAuthentication Library
	  https://github.com/MicrochipTech/cryptoauthlib/wiki
```

## os/package/python-litex/Config.in
```kconfig
config BR2_PACKAGE_PYTHON_LITEX
	bool "python-litex"

	depends on BR2_PACKAGE_PYTHON3
        select BR2_PACKAGE_PYTHON_MIGEN
        select BR2_PACKAGE_PYTHON_PACKAGING
        select BR2_PACKAGE_PYTHON_REQUESTS



	help
	  Litex
	  
```

## os/package/python-migen/Config.in
```kconfig
config BR2_PACKAGE_PYTHON_MIGEN
	bool "python-migen"

	depends on BR2_PACKAGE_PYTHON3

	help
	  Litex
	  
```

## os/package/python-spearf1sh-api-server/Config.in
```kconfig
  config BR2_PACKAGE_PYTHON_SPEARF1SH_API_SERVER
	bool "python-spearf1sh-api-server"
	depends on BR2_PACKAGE_PYTHON3
	depends on BR2_PACKAGE_PYTHON_FLASK
        depends on BR2_PACKAGE_PYTHON_PERIPHERY
	help
          Spearf1sh REST API
```

## os/package/spearf0rth/Config.in
```kconfig
  config BR2_PACKAGE_SPEARF0RTH
	bool "spearf0rth"
	help
	  A FORTH flavor for use with spearf1sh. 
```

## os/package/tpm-simulator/Config.in
```kconfig
  config BR2_PACKAGE_TPM_SIMULATOR
	bool "tpm-simulator"
	help
	  Userspace Runs the tpm simulator as a service.
```
